## Kconfig
```kconfig
#
# Copyright (c) 2023 Nordic Semiconductor
#
# SPDX-License-Identifier: BSD-3-Clause
#

rsource "drivers/Kconfig"
```

## drivers/npmx/Kconfig
```kconfig
#
# Copyright (c) 2022-2023 Nordic Semiconductor ASA
#
# SPDX-License-Identifier: BSD-3-Clause
#

config NPMX
	bool "Enable npmx"

if NPMX

config NPMX_RESTORE_VALUES
	bool "Restore values"
	help
	  Restore values from nPM1300 after the SoC reset.

config NPMX_INIT_PRIORITY
	int "NPMX init priority"
	default 90
	help
	  NPMX initialization priority.

config NPMX_DEVICE_NPM1300
	bool "nPM1300"
	default y
	select I2C
	depends on DT_HAS_NORDIC_NPMX_NPM1300_ENABLED
	help
	  nPM1300 PMIC.

config NPMX_DEVICE_NPM1304
	bool "nPM1304"
	default y
	select I2C
	depends on DT_HAS_NORDIC_NPMX_NPM1304_ENABLED
	help
	  nPM1304 PMIC.

config NPMX_SHELL
	depends on SHELL
	bool "Turn on npmx shell commands"

module = NPMX
module-str = npmx
source "subsys/logging/Kconfig.template.log_config"

endif # NPMX
```

## dts/bindings/mfd/nordic,npmx-npm1300.yaml
```yaml
#
# Copyright (c) 2022-2023 Nordic Semiconductor ASA
#
# SPDX-License-Identifier: BSD-3-Clause
#

description: |
    This is a representation of the nPM1300 PMIC device.

compatible: "nordic,npmx-npm1300"

include: i2c-device.yaml

properties:
  host-int-gpios:
    type: phandle-array
    required: true
    description: |
      Host GPIO pin used as interrupt input.
  pmic-int-pin:
    type: int
    required: true
    description: |
      nPM GPIO pin number used as interrupt output.
  host-pof-gpios:
    type: phandle-array
    description: |
      Host GPIO pin used as power loss warning input.
  pmic-pof-pin:
    type: int
    description: |
      nPM GPIO pin number used as power loss warning output.
  pmic-reset-pin:
    type: int
    description: |
      nPM GPIO pin number used as watchdog warning reset output.
```

## dts/bindings/mfd/nordic,npmx-npm1304.yaml
```yaml
#
# Copyright (c) 2025 Nordic Semiconductor ASA
#
# SPDX-License-Identifier: BSD-3-Clause
#

description: |
    This is a representation of the nPM1304 PMIC device.

compatible: "nordic,npmx-npm1304"

include: i2c-device.yaml

properties:
  host-int-gpios:
    type: phandle-array
    description: |
      Host GPIO pin used as interrupt input.
  pmic-int-pin:
    type: int
    description: |
      nPM GPIO pin number used as interrupt output.
  host-pof-gpios:
    type: phandle-array
    description: |
      Host GPIO pin used as power loss warning input.
  pmic-pof-pin:
    type: int
    description: |
      nPM GPIO pin number used as power loss warning output.
  pmic-reset-pin:
    type: int
    description: |
      nPM GPIO pin number used as watchdog warning reset output.
```

## samples/buck_output_advanced/sample.yaml
```yaml
#
# Copyright (c) 2023 Nordic Semiconductor ASA
#
# SPDX-License-Identifier: BSD-3-Clause
#

sample:
  description: Buck output advanced sample
  name: nPM1300 PMIC BUCK Output Advanced sample

common:
  integration_platforms:
    - nrf5340dk/nrf5340/cpuapp
    - nrf52840dk/nrf52840
  platform_allow:
    - nrf5340dk/nrf5340/cpuapp
    - nrf52840dk/nrf52840
  tags: pmic
  timeout: 30

tests:
  sample.buck_output_advanced:
    harness: console
    harness_config:
      fixture: nPM130x_setup
      type: multi_line
      ordered: true
      regex:
        - "PMIC device OK."
        - "Test output voltage."
        - "Voltage BUCK1:"
        - "Test output voltage OK."
```

## samples/buck_retention/sample.yaml
```yaml
#
# Copyright (c) 2023 Nordic Semiconductor ASA
#
# SPDX-License-Identifier: BSD-3-Clause
#

sample:
  description: Buck retention sample
  name: nPM1300 PMIC BUCK retention sample

common:
  integration_platforms:
    - nrf5340dk_nrf5340_cpuapp
    - nrf52840dk_nrf52840
  platform_allow: nrf5340dk_nrf5340_cpuapp nrf52840dk_nrf52840
  tags: pmic
  timeout: 30

tests:
  sample.buck_retention:
    extra_args: CONFIG_NPMX_DEVICE_NPM1300=y
    harness: console
    harness_config:
      fixture: nPM1300_setup
      type: multi_line
      ordered: true
      regex:
        - "PMIC device OK."
        - "Test retention voltage."
        - "Test retention voltage OK."
```

## samples/ldsw/Kconfig
```kconfig
#
# Copyright (c) 2022 Nordic Semiconductor ASA
#
# SPDX-License-Identifier: BSD-3-Clause
#

mainmenu "LDSW sample"

choice
	prompt "Testcase selection."
	default TESTCASE_SW_ENABLE

config TESTCASE_SW_ENABLE
	bool "Enable and disable load switches with SW."

config TESTCASE_GPIO_ENABLE
	bool "Enable and disable load switches with GPIO pins."

endchoice

source "Kconfig.zephyr"
```

## samples/ldsw/sample.yaml
```yaml
#
# Copyright (c) 2023 Nordic Semiconductor ASA
#
# SPDX-License-Identifier: BSD-3-Clause
#

sample:
  description: LDSW sample
  name: LDSW

common:
  integration_platforms:
    - nrf5340dk/nrf5340/cpuapp
    - nrf52840dk/nrf52840
  platform_allow:
    - nrf5340dk/nrf5340/cpuapp
    - nrf52840dk/nrf52840
  tags: pmic
  timeout: 30

tests:
  sample.ldsw.sw_enable:
    extra_args: CONFIG_TESTCASE_SW_ENABLE=y
    harness: console
    harness_config:
      fixture: nPM130x_setup
      type: multi_line
      ordered: true
      regex:
        - "PMIC device OK."
        - "Test enable LDSW with software."
        - "Test enable LDSW with software OK."

  sample.ldsw.gpio_enable:
    extra_args: CONFIG_TESTCASE_GPIO_ENABLE=y
    harness: console
    harness_config:
      fixture: nPM130x_setup
      type: multi_line
      ordered: true
      regex:
        - "PMIC device OK."
        - "Test enable LDSW via connected pin."
        - "Test enable LDSW via connected pin OK."
```

## samples/led/sample.yaml
```yaml
#
# Copyright (c) 2023 Nordic Semiconductor ASA
#
# SPDX-License-Identifier: BSD-3-Clause
#

sample:
  description: LED sample
  name: LED

common:
  integration_platforms:
    - nrf5340dk/nrf5340/cpuapp
    - nrf52840dk/nrf52840
  platform_allow:
    - nrf5340dk/nrf5340/cpuapp
    - nrf52840dk/nrf52840
  tags: pmic
  timeout: 30

tests:
  sample.led:
    harness: console
    harness_config:
      fixture: nPM130x_setup
      type: multi_line
      ordered: true
      regex:
        - "PMIC device OK."
        - "LEDs blinking."
```

## west.yml
```yaml
#
# Copyright (c) 2023 Nordic Semiconductor ASA
#
# SPDX-License-Identifier: BSD-3-Clause
#

# The west manifest file (west.yml) for npmx-zephyr.

manifest:
  defaults:
    remote: NordicSemiconductor

  remotes:
    - name: NordicSemiconductor
      url-base: https://github.com/NordicSemiconductor
    - name: nrfconnect
      url-base: https://github.com/nrfconnect
    - name: zephyrproject
      url-base: https://github.com/zephyrproject-rtos

  projects:
    - name: npmx
      remote: NordicSemiconductor
      path: npmx
      revision: 3312e7763c8f9c1651bfdf996c6b581f79b6bdcf
    - name: nrf
      remote: nrfconnect
      repo-path: sdk-nrf
      path: nrf
      revision: v3.0.0
      import:
        name-allowlist:
          - zephyr
          - nrfxlib
          - hal_nordic
          - open-amp
          - libmetal
          - cmsis
          - cmsis_6
          - segger
```
