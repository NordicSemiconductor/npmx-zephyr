## CMakeLists.txt
```
#
# Copyright (c) 2023 Nordic Semiconductor ASA
#
# SPDX-License-Identifier: BSD-3-Clause
#

cmake_minimum_required(VERSION 3.20.0)
find_package(Zephyr REQUIRED HINTS $ENV{ZEPHYR_BASE})
project(pmic_fuel_gauge)

FILE(GLOB app_sources src/*.c)
target_sources(app PRIVATE ${app_sources})
```

## Kconfig
```
#
# Copyright (c) 2023 Nordic Semiconductor ASA
#
# SPDX-License-Identifier: BSD-3-Clause
#

mainmenu "Fuel Gauge example"
	choice
		prompt "VBUSIN current limit"
		default CURRENT_LIMIT_500

		config CURRENT_LIMIT_100
			bool "100 mA"
		config CURRENT_LIMIT_500
			bool "500 mA"
		config CURRENT_LIMIT_600
			bool "600 mA"
		config CURRENT_LIMIT_700
			bool "700 mA"
		config CURRENT_LIMIT_800
			bool "800 mA"
		config CURRENT_LIMIT_900
			bool "900 mA"
		config CURRENT_LIMIT_1000
			bool "1000 mA"
		config CURRENT_LIMIT_1100
			bool "1100 mA"
		config CURRENT_LIMIT_1200
			bool "1200 mA"
		config CURRENT_LIMIT_1300
			bool "1300 mA"
		config CURRENT_LIMIT_1400
			bool "1400 mA"
		config CURRENT_LIMIT_1500
			bool "1500 mA"
	endchoice

	config CURRENT_LIMIT
		int
		default 100 if CURRENT_LIMIT_100
		default 500 if CURRENT_LIMIT_500
		default 600 if CURRENT_LIMIT_600
		default 700 if CURRENT_LIMIT_700
		default 800 if CURRENT_LIMIT_800
		default 900 if CURRENT_LIMIT_900
		default 1000 if CURRENT_LIMIT_1000
		default 1100 if CURRENT_LIMIT_1100
		default 1200 if CURRENT_LIMIT_1200
		default 1300 if CURRENT_LIMIT_1300
		default 1400 if CURRENT_LIMIT_1400
		default 1500 if CURRENT_LIMIT_1500

	menu "Battery configuration"
		config CHARGING_CURRENT
			int "Battery charging current (in milliamperes)"
			help
				Available range is 32 mA to 800 mA in 2 mA steps.
				The value specified will be rounded down to the closest implemented value.
			range 32 800
			default 150

		choice
			prompt "Battery discharge current limit (in milliamperes)"
			default DISCHARGING_CURRENT_1000

			config DISCHARGING_CURRENT_1000
				bool "1000 mA"
			config DISCHARGING_CURRENT_200
				bool "200 mA"
		endchoice

		choice
			prompt "Battery termination voltage in normal temperature"
			default TERM_NORMAL_4150

			config TERM_NORMAL_3500
				bool "3.50 V"
			config TERM_NORMAL_3550
				bool "3.55 V"
			config TERM_NORMAL_3600
				bool "3.60 V"
			config TERM_NORMAL_3650
				bool "3.65 V"
			config TERM_NORMAL_4000
				bool "4.00 V"
			config TERM_NORMAL_4050
				bool "4.05 V"
			config TERM_NORMAL_4100
				bool "4.10 V"
			config TERM_NORMAL_4150
				bool "4.15 V"
			config TERM_NORMAL_4200
				bool "4.20 V"
			config TERM_NORMAL_4250
				bool "4.25 V"
			config TERM_NORMAL_4300
				bool "4.30 V"
			config TERM_NORMAL_4350
				bool "4.35 V"
			config TERM_NORMAL_4400
				bool "4.40 V"
			config TERM_NORMAL_4450
				bool "4.45 V"
		endchoice

		config TERMINATION_VOLTAGE_NORMAL
			int
			default 3500 if TERM_NORMAL_3500
			default 3550 if TERM_NORMAL_3550
			default 3600 if TERM_NORMAL_3600
			default 3650 if TERM_NORMAL_3650
			default 4000 if TERM_NORMAL_4000
			default 4050 if TERM_NORMAL_4050
			default 4100 if TERM_NORMAL_4100
			default 4150 if TERM_NORMAL_4150
			default 4200 if TERM_NORMAL_4200
			default 4250 if TERM_NORMAL_4250
			default 4300 if TERM_NORMAL_4300
			default 4350 if TERM_NORMAL_4350
			default 4400 if TERM_NORMAL_4400
			default 4450 if TERM_NORMAL_4450

		choice
			prompt "Battery termination voltage in warm temperature"
			default TERM_WARM_4000

			config TERM_WARM_3500
				bool "3.50 V"
			config TERM_WARM_3550
				bool "3.55 V"
			config TERM_WARM_3600
				bool "3.60 V"
			config TERM_WARM_3650
				bool "3.65 V"
			config TERM_WARM_4000
				bool "4.00 V"
			config TERM_WARM_4050
				bool "4.05 V"
			config TERM_WARM_4100
				bool "4.10 V"
			config TERM_WARM_4150
				bool "4.15 V"
			config TERM_WARM_4200
				bool "4.20 V"
			config TERM_WARM_4250
				bool "4.25 V"
			config TERM_WARM_4300
				bool "4.30 V"
			config TERM_WARM_4350
				bool "4.35 V"
			config TERM_WARM_4400
				bool "4.40 V"
			config TERM_WARM_4450
				bool "4.45 V"
		endchoice

		config TERMINATION_VOLTAGE_WARM
			int
			default 3500 if TERM_WARM_3500
			default 3550 if TERM_WARM_3550
			default 3600 if TERM_WARM_3600
			default 3650 if TERM_WARM_3650
			default 4000 if TERM_WARM_4000
			default 4050 if TERM_WARM_4050
			default 4100 if TERM_WARM_4100
			default 4150 if TERM_WARM_4150
			default 4200 if TERM_WARM_4200
			default 4250 if TERM_WARM_4250
			default 4300 if TERM_WARM_4300
			default 4350 if TERM_WARM_4350
			default 4400 if TERM_WARM_4400
			default 4450 if TERM_WARM_4450
	endmenu

    menu "Thermistor configuration"
        choice
            prompt "Thermistor nominal resistance in Ohms"
            default RES_10000

            config RES_10000
                bool "10 kOhm"
            config RES_47000
                bool "47 kOhm"
            config RES_100000
                bool "100 kOhm"
        endchoice

        config THERMISTOR_RESISTANCE
            int
            default 10000 if RES_10000
	        default 47000 if RES_47000
	        default 100000 if RES_100000

        config THERMISTOR_BETA
            int "Thermistor beta value"
            default 3380
    endmenu

source "Kconfig.zephyr"
```

## sample.yaml
```
#
# Copyright (c) 2023 Nordic Semiconductor ASA
#
# SPDX-License-Identifier: BSD-3-Clause
#

sample:
  description: Fuel gauge sample
  name: Fuel gauge

common:
  integration_platforms:
    - nrf5340dk/nrf5340/cpuapp
    - nrf52840dk/nrf52840
  platform_allow:
    - nrf5340dk/nrf5340/cpuapp
    - nrf52840dk/nrf52840
  tags: pmic

tests:
  sample.fuel_gauge:
    harness: console
    harness_config:
      fixture: nPM1300_with_battery_setup
      type: multi_line
      ordered: false
      regex:
        - "PMIC device OK."
        - "Fuel gauge OK."
        - "V: .+, I: .+, T: .+, SoC: .+, TTE: .+, TTF: .+"
```

## prj.conf
```kconfig
#
# Copyright (c) 2023 Nordic Semiconductor ASA
#
# SPDX-License-Identifier: BSD-3-Clause
#

CONFIG_MAIN_STACK_SIZE=2048

CONFIG_SERIAL=y
CONFIG_CONSOLE=y
CONFIG_UART_CONSOLE=y

CONFIG_I2C=y
CONFIG_NPMX=y
CONFIG_LOG=y
CONFIG_NPMX_LOG_LEVEL_DBG=y
CONFIG_SHELL=y
CONFIG_ASSERT=y

# Core Dump configuraion
CONFIG_DEBUG_COREDUMP=y
CONFIG_DEBUG_COREDUMP_BACKEND_LOGGING=y

CONFIG_NRF_FUEL_GAUGE=y
CONFIG_NRF_FUEL_GAUGE_VARIANT_SECONDARY_CELL=y
CONFIG_REQUIRES_FLOAT_PRINTF=y
```

## src/main.c
```c
/*
 * Copyright (c) 2023 Nordic Semiconductor ASA
 *
 * SPDX-License-Identifier: BSD-3-Clause
 */

#include <zephyr/logging/log.h>
#include <zephyr/kernel.h>
#include <npmx_driver.h>

#include "nrf_fuel_gauge.h"
#include "fuel_gauge.h"

#define LOG_MODULE_NAME main
LOG_MODULE_REGISTER(LOG_MODULE_NAME);

/**
 * @brief Callback function to be used when VBUSIN VOLTAGE event occurs.
 *
 * @param[in] p_pm Pointer to the instance of PMIC device.
 * @param[in] type Callback type. Should be @ref NPMX_CALLBACK_TYPE_EVENT_VBUSIN_VOLTAGE.
 * @param[in] mask Received event interrupt mask.
 */
void vbusin_voltage_callback(npmx_instance_t *p_pm, npmx_callback_type_t type, uint8_t mask)
{
	/* Current limit have to be applied each time when USB is (re)connected. */
	if (mask & NPMX_EVENT_GROUP_VBUSIN_DETECTED_MASK) {
		npmx_vbusin_task_trigger(npmx_vbusin_get(p_pm, 0),
					 NPMX_VBUSIN_TASK_APPLY_CURRENT_LIMIT);
	}
}

int main(void)
{
	const struct device *pmic_dev = DEVICE_DT_GET(DT_NODELABEL(npm_0));

	if (!device_is_ready(pmic_dev)) {
		LOG_ERR("PMIC device is not ready.");
		return 0;
	}

	LOG_INF("PMIC device OK.");

	/* Get pointer to npmx instance and other required instances. */
	npmx_instance_t *npmx_instance = npmx_driver_instance_get(pmic_dev);
	npmx_charger_t *charger_instance = npmx_charger_get(npmx_instance, 0);
	npmx_vbusin_t *vbusin_instance = npmx_vbusin_get(npmx_instance, 0);
	npmx_adc_t *adc_instance = npmx_adc_get(npmx_instance, 0);

	/* Register callback for VBUSIN VOLTAGE event. */
	npmx_core_register_cb(npmx_instance, vbusin_voltage_callback,
			      NPMX_CALLBACK_TYPE_EVENT_VBUSIN_VOLTAGE);

	/* Enable detecting connected USB. */
	npmx_core_event_interrupt_enable(npmx_instance, NPMX_EVENT_GROUP_VBUSIN_VOLTAGE,
					 NPMX_EVENT_GROUP_VBUSIN_DETECTED_MASK);

	/* Disable charger before changing charge current and termination voltage. */
	npmx_charger_module_disable_set(charger_instance, NPMX_CHARGER_MODULE_CHARGER_MASK);

	/* Set charging current. */
	npmx_charger_charging_current_set(charger_instance, CONFIG_CHARGING_CURRENT);

	/* Set maximum discharging current. */
	if (IS_ENABLED(CONFIG_DISCHARGING_CURRENT_1000)) {
		npmx_charger_discharging_current_set(charger_instance, 1000);
	} else if (IS_ENABLED(CONFIG_DISCHARGING_CURRENT_200)) {
		npmx_charger_discharging_current_set(charger_instance, 200);
	}

	/* Set battery termination voltage in normal temperature. */
	npmx_charger_termination_normal_voltage_set(
		charger_instance, npmx_charger_voltage_convert(CONFIG_TERMINATION_VOLTAGE_NORMAL));

	/* Set battery termination voltage in warm temperature. */
	npmx_charger_termination_warm_voltage_set(
		charger_instance, npmx_charger_voltage_convert(CONFIG_TERMINATION_VOLTAGE_WARM));

	/* Enable charger. */
	npmx_charger_module_enable_set(charger_instance, NPMX_CHARGER_MODULE_CHARGER_MASK);

	/* Set the current limit for the USB port.
	 * Current limit needs to be applied after each USB (re)connection.
	 */
	npmx_vbusin_current_limit_set(vbusin_instance,
				      npmx_vbusin_current_convert(CONFIG_CURRENT_LIMIT));

	/* Apply current limit. */
	npmx_vbusin_task_trigger(vbusin_instance, NPMX_VBUSIN_TASK_APPLY_CURRENT_LIMIT);

	npmx_adc_ntc_config_t ntc_config = { .type = npmx_adc_ntc_type_convert(
						     CONFIG_THERMISTOR_RESISTANCE),
					     .beta = CONFIG_THERMISTOR_BETA };

	/* Set thermistor type and NTC beta value for ADC measurements. */
	npmx_adc_ntc_config_set(adc_instance, &ntc_config);

	/* Enable auto measurement of the battery current after the battery voltage measurement. */
	npmx_adc_ibat_meas_enable_set(adc_instance, true);

	/* Trigger required ADC measurements. */
	npmx_adc_task_trigger(adc_instance, NPMX_ADC_TASK_SINGLE_SHOT_VBAT);
	npmx_adc_task_trigger(adc_instance, NPMX_ADC_TASK_SINGLE_SHOT_NTC);

	if (fuel_gauge_init(npmx_instance) < 0) {
		LOG_ERR("Fuel gauge initialization failed.");
		return 0;
	}

	LOG_INF("Fuel gauge OK.");

	while (1) {
		k_msleep(1000);
		fuel_gauge_update(npmx_instance);
	}

	return 0;
}
```

## src/fuel_gauge.c
```c
/*
 * Copyright (c) 2023 Nordic Semiconductor ASA
 *
 * SPDX-License-Identifier: BSD-3-Clause
 */

#include <zephyr/logging/log.h>
#include <zephyr/kernel.h>
#include <npmx_driver.h>
#include "nrf_fuel_gauge.h"
#include "fuel_gauge.h"
#include <math.h>

#define LOG_MODULE_NAME fuel_gauge
LOG_MODULE_REGISTER(LOG_MODULE_NAME);

static const struct battery_model battery_model = {
#include "battery_model.inc"
};

static float max_charge_current;
static float term_charge_current;
static int64_t ref_time;

static int read_sensors(npmx_instance_t *const p_pm, float *voltage, float *current, float *temp)
{
	npmx_adc_t *adc_instance = npmx_adc_get(p_pm, 0);
	npmx_adc_meas_all_t meas;

	if (npmx_adc_meas_all_get(adc_instance, &meas) != NPMX_SUCCESS) {
		LOG_ERR("Reading ADC measurements failed.");
		return -EIO;
	}

	if (npmx_adc_task_trigger(adc_instance, NPMX_ADC_TASK_SINGLE_SHOT_VBAT) != NPMX_SUCCESS) {
		LOG_ERR("Triggering VBAT measurement failed.");
		return -EIO;
	}

	if (npmx_adc_task_trigger(adc_instance, NPMX_ADC_TASK_SINGLE_SHOT_NTC) != NPMX_SUCCESS) {
		LOG_ERR("Triggering NTC measurement failed.");
		return -EIO;
	}

	/* Convert current in microamperes to current in amperes. */
	*current = (float)meas.values[NPMX_ADC_MEAS_VBAT2_IBAT] / 1000000.0f;

	/* Convert temperature in millidegrees Celsius to temperature in Celsius */
	*temp = (float)meas.values[NPMX_ADC_MEAS_BAT_TEMP] / 1000.0f;

	/* Convert voltage in millivolts to voltage in volts. */
	*voltage = (float)meas.values[NPMX_ADC_MEAS_VBAT] / 1000.0f;

	return 0;
}

static int process_vbus_state(npmx_instance_t *const p_pm)
{
	npmx_vbusin_t *vbus_instance = npmx_vbusin_get(p_pm, 0);
	enum nrf_fuel_gauge_ext_state_info_type state_info;
	uint8_t vbusin_status;

	if (npmx_vbusin_vbus_status_get(vbus_instance, &vbusin_status) != NPMX_SUCCESS) {
		LOG_ERR("Reading VBUS status failed.");
		return -EIO;
	}

	if (vbusin_status & NPMX_VBUSIN_STATUS_CONNECTED_MASK) {
		state_info = NRF_FUEL_GAUGE_EXT_STATE_INFO_VBUS_CONNECTED;
	} else {
		state_info = NRF_FUEL_GAUGE_EXT_STATE_INFO_VBUS_DISCONNECTED;
	}

	return nrf_fuel_gauge_ext_state_update(state_info, NULL);
}

static int process_charger_state(npmx_instance_t *const p_pm)
{
	npmx_charger_t *charger_instance = npmx_charger_get(p_pm, 0);
	union nrf_fuel_gauge_ext_state_info_data state_info;
	uint8_t charger_status;

	if (npmx_charger_status_get(charger_instance, &charger_status) != NPMX_SUCCESS) {
		LOG_ERR("Reading charger status failed.");
		return -EIO;
	}

	if (charger_status & NPMX_CHARGER_STATUS_COMPLETED_MASK) {
		LOG_INF("Charge complete");
		state_info.charge_state = NRF_FUEL_GAUGE_CHARGE_STATE_COMPLETE;
	} else if (charger_status & NPMX_CHARGER_STATUS_TRICKLE_CHARGE_MASK) {
		LOG_INF("Trickle charging");
		state_info.charge_state = NRF_FUEL_GAUGE_CHARGE_STATE_TRICKLE;
	} else if (charger_status & NPMX_CHARGER_STATUS_CONSTANT_CURRENT_MASK) {
		LOG_INF("Constant current charging");
		state_info.charge_state = NRF_FUEL_GAUGE_CHARGE_STATE_CC;
	} else if (charger_status & NPMX_CHARGER_STATUS_CONSTANT_VOLTAGE_MASK) {
		LOG_INF("Constant voltage charging");
		state_info.charge_state = NRF_FUEL_GAUGE_CHARGE_STATE_CV;
	} else {
		LOG_INF("Charger idle");
		state_info.charge_state = NRF_FUEL_GAUGE_CHARGE_STATE_IDLE;
	}

	return nrf_fuel_gauge_ext_state_update(NRF_FUEL_GAUGE_EXT_STATE_INFO_CHARGE_STATE_CHANGE,
					       &state_info);
}

int fuel_gauge_init(npmx_instance_t *const p_pm)
{
	struct nrf_fuel_gauge_init_parameters parameters = {
		.model = &battery_model,
		.opt_params = NULL,
		.state = NULL,
	};
	npmx_charger_t *charger_instance = npmx_charger_get(p_pm, 0);
	npmx_charger_iterm_t iterm;
	npmx_error_t npmx_err;
	uint32_t iterm_pct;
	uint32_t charge_current_limit_uA;
	float charge_current_limit;
	float term_current;
	int ret;

	ret = read_sensors(p_pm, &parameters.v0, &parameters.i0, &parameters.t0);
	if (ret < 0) {
		return ret;
	}

	/* Store charge nominal and termination current, needed for ttf calculation */
	max_charge_current = CONFIG_CHARGING_CURRENT / 1000.0f;
	term_charge_current = max_charge_current / 10.f;

	nrf_fuel_gauge_init(&parameters, NULL);

	ref_time = k_uptime_get();

	npmx_err = npmx_charger_charging_current_get(charger_instance, &charge_current_limit_uA);
	if (npmx_err != NPMX_SUCCESS) {
		return -EIO;
	}

	npmx_err = npmx_charger_termination_current_get(charger_instance, &iterm);
	if (npmx_err != NPMX_SUCCESS) {
		return -EIO;
	}

	if (!npmx_charger_iterm_convert_to_pct(iterm, &iterm_pct)) {
		return -EIO;
	}

	charge_current_limit = (float)charge_current_limit_uA / 1000000.f;
	term_current = charge_current_limit * (float)iterm_pct / 100.f;

	ret = nrf_fuel_gauge_ext_state_update(NRF_FUEL_GAUGE_EXT_STATE_INFO_CHARGE_CURRENT_LIMIT,
					      &(union nrf_fuel_gauge_ext_state_info_data){
						      .charge_current_limit = charge_current_limit});
	if (ret < 0) {
		return ret;
	}

	ret = nrf_fuel_gauge_ext_state_update(NRF_FUEL_GAUGE_EXT_STATE_INFO_TERM_CURRENT,
					      &(union nrf_fuel_gauge_ext_state_info_data){
						      .charge_term_current = term_current});
	if (ret < 0) {
		return ret;
	}

	return 0;
}

int fuel_gauge_update(npmx_instance_t *const p_pm)
{
	float voltage;
	float current;
	float temp;
	float soc;
	float tte;
	float ttf;
	float delta;
	int ret;

	ret = process_vbus_state(p_pm);
	if (ret < 0) {
		LOG_ERR("Error: Could not process VBUS state.");
		return ret;
	}

	ret = process_charger_state(p_pm);
	if (ret < 0) {
		LOG_ERR("Error: Could not process charger state.");
		return ret;
	}

	ret = read_sensors(p_pm, &voltage, &current, &temp);
	if (ret < 0) {
		LOG_ERR("Error: Could not read data from charger device.");
		return ret;
	}

	delta = (float)k_uptime_delta(&ref_time) / 1000.f;

	soc = nrf_fuel_gauge_process(voltage, current, temp, delta, NULL);
	tte = nrf_fuel_gauge_tte_get();
	ttf = nrf_fuel_gauge_ttf_get();

	LOG_INF("V: %.3f, I: %.3f, T: %.2f, SoC: %.2f, TTE: %.0f, TTF: %.0f", (double)voltage, (double)current,
		(double)temp, (double)soc, (double)tte, (double)ttf);

	return 0;
}
```

## src/fuel_gauge.h
```c
/*
 * Copyright (c) 2023 Nordic Semiconductor ASA
 *
 * SPDX-License-Identifier: BSD-3-Clause
 */

#ifndef __FUEL_GAUGE_H__
#define __FUEL_GAUGE_H__

#include <npmx_driver.h>

/**
 * @brief Function for initializing the fuel gauge module.
 *
 * @param[in] p_pm Pointer to the instance of PMIC device.
 *
 * @retval 0     On success.
 * @retval other Errno codes.
 */
int fuel_gauge_init(npmx_instance_t *const p_pm);

/**
 * @brief Function for periodically updating the fuel gauge module with battery voltage, current and temperature.
 *
 * @param[in] p_pm Pointer to the instance of PMIC device.
 *
 * @retval 0     On success.
 * @retval other Errno codes.
 */
int fuel_gauge_update(npmx_instance_t *const p_pm);

#endif /* __FUEL_GAUGE_H__ */
```
